#include <Wire.h>
#include <SPI.h>
#include <Adafruit_GFX.h>
#include <Adafruit_SSD1306.h>

#define fsr_pin A0
#define OLED_MOSI   11 //D1
#define OLED_CLK   12 //D0
#define OLED_DC    9 //DC
#define OLED_CS    8 //CS
#define OLED_RESET 10 //RES
Adafruit_SSD1306 display(OLED_MOSI, OLED_CLK, OLED_DC, OLED_RESET, OLED_CS);
int logo_now = 1;

static const unsigned char PROGMEM Logo_1[] = {
  0x00,0x00,0x00,0x00,0x00,0x00,0x00,0x00,
  0x00,0x00,0x00,0x0f,0x80,0x00,0x00,0x00,
  0x00,0x00,0x01,0xff,0xfc,0x00,0x00,0x00,
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  0x00,0x00,0x00,0x00,0x00,0x00,0x00,0x00,
};

static const uint8_t Logo_2[] PROGMEM = {
  B00000000, B00000000, B00000000, B00000000, B00000000, B00000000, B00000000, B00000000, 
  B00000000, B00000000, B00000000, B00000000, B00000000, B00000000, B00000000, B00000000, 
  B00000000, B00000000, B00000000, B00000001, B10000000, B00000000, B00000000, B00000000, 
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  B00000000, B01000000, B00000000, B00000000, B00000000, B00000000, B00000001, B00000000, 
  
};

void setup() {
  Serial.begin(9600);

   pinMode(0, OUTPUT);
    pinMode(1, OUTPUT);
     pinMode(2, OUTPUT);
      pinMode(3, OUTPUT);
       pinMode(4, OUTPUT);
        pinMode(5, OUTPUT);
         pinMode(6, OUTPUT);
          pinMode(7, OUTPUT);
  display.begin(SSD1306_SWITCHCAPVCC);
  
}

void loop() {
    int fsr_value = analogRead(fsr_pin); // 讀取FSR
    int led_value = map(fsr_value, 0, 1023, 0, 7); // 從0~1023映射到0~255
  
    //analogWrite(led_pin, led_value); // 改變LED亮度
  
    if(led_value >=4  && logo_now != 1){
       logo_now = 1;
       print_1();
    }

    if(led_value <4 && logo_now != 2){
     logo_now = 2;
     print_2();

    for(int x=0; x<=7; x++){
           analogWrite(x, false);
    }
    if(led_value>=0)analogWrite(0, true);
    if(led_value>=1)analogWrite(1, true);
    if(led_value>=2)analogWrite(2, true);
    if(led_value>=3)analogWrite(3, true);
    if(led_value>=4)analogWrite(4, true);
    if(led_value>=5)analogWrite(5, true);
    if(led_value>=6)analogWrite(6, true);
    if(led_value>=7)analogWrite(7, true);

  }
  
  Serial.println(fsr_value);
  Serial.println(led_value);
  Serial.println("-------------");
}

void print_1(){
  display.clearDisplay();
  display.drawBitmap(23,0,Logo_1,64 ,32,WHITE);
  display.display();
}

void print_2(){
  display.clearDisplay();
  display.drawBitmap(23,0,Logo_2,64 ,32,WHITE);
  display.display();
}


